## Kconfig
```kconfig
# Sensor Rotation Module Configuration

menuconfig SENSOR_ROTATION
    bool "Enable Sensor Rotation Module"
    default n
    help
        Enable the sensor rotation module for ZMK.

if SENSOR_ROTATION

config SENSOR_ROTATION_ANGLE
    int "Sensor rotation angle (degrees)"
    default 0
    range 0 360
    help
        Angle to rotate the sensor XY coordinates (0 to 360 degrees).

endif # SENSOR_ROTATION
```

## dts/bindings/input_processors/zmk,input-processor-sensor-rotation.yaml
```yaml
# Copyright (c) 2025, Takuya Urakawa(@hsgw), 5z6p.com
# SPDX-License-Identifier: MIT

description: Input Processor for sensor rotation

compatible: "zmk,input-processor-sensor-rotation"

include: ip_zero_param.yaml

properties:
  rotation-angle:
    type: int
    required: true
```

## west.yml
```yaml
manifest:
  remotes:
    - name: hsgw
      url-base: https://github.com/hsgw
  projects:
    # Together with the above defined remote, this refers to a module located at
    # https://github.com/remote-name/repository-name
    - name: zmk-feature-sensor_rotation
      remote: hsgw
      # This points to a west manifest file in the remote module for further imports
      import: west.yml
```
